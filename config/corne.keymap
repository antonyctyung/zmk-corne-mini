// Copyright 2023 Manna Harbour
// https://github.com/manna-harbour/miryoku

#include "./miryoku/custom_config.h"
#define MIRYOKU_TAP_QWERTY
#define MIRYOKU_NAV_VI
#include "./miryoku/mapping/42/corne.h"
#include "./miryoku/miryoku.dtsi"
